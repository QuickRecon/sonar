## Firmware/main/Kconfig.projbuild
```kconfig
menu "SonarMK2 Configuration"

    config SONARMK2_WIFI_SSID
        string "WiFi AP SSID"
        default "SonarMK2"
        help
            SSID (network name) for the SonarMK2 WiFi access point.

    config SONARMK2_WIFI_PASSWORD
        string "WiFi AP Password"
        default ""
        help
            Password for the SonarMK2 WiFi access point.
            Leave empty for an open network.

    config SONARMK2_WIFI_CHANNEL
        int "WiFi Channel"
        default 1
        range 1 13
        help
            WiFi channel for the access point.

    config SONARMK2_MAX_STA_CONN
        int "Max Station Connections"
        default 4
        range 1 4
        help
            Maximum number of stations that can connect to the AP.

endmenu
```

## Firmware/sdkconfig.defaults
```kconfig
CONFIG_PARTITION_TABLE_CUSTOM=y
CONFIG_PARTITION_TABLE_CUSTOM_FILENAME="partitions.csv"
CONFIG_HTTPD_WS_SUPPORT=y
CONFIG_ESP_MAIN_TASK_STACK_SIZE=8192
CONFIG_FREERTOS_HZ=1000
CONFIG_LWIP_DHCPS_MAX_STATION_NUM=4
CONFIG_LWIP_MAX_SOCKETS=16
CONFIG_FREERTOS_USE_TRACE_FACILITY=y
CONFIG_FREERTOS_GENERATE_RUN_TIME_STATS=y
CONFIG_ESP_HTTPS_SERVER_ENABLE=y
CONFIG_MBEDTLS_TLS_SERVER=y
CONFIG_MBEDTLS_SSL_IN_CONTENT_LEN=4096
CONFIG_MBEDTLS_SSL_OUT_CONTENT_LEN=4096
```
